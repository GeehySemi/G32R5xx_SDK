# G32R502 register map
Vendor: Geehy Semiconductor Co., Ltd.; Series: G32R5; File version: 1.0
CPU: CM52 r0p1, little endian, MPU, FPU, DSP, VTOR, 4 interrupt priority bits
Registers are 32-bit, read-write, reset 0x0 unless marked. A register's access mark holds for its fields unless they carry their own. Offsets are from the block's base; lines under a group give offsets from that group; [hi:lo] are bit positions; {n}, {i} and the like mark numbered series; 'fields as' and 'values as' point back to an identical list; <NAME> marks a mode.

## Memory map
0x40000000 DCCOMP0 size 0x400 — Dual-Clock Comparator
0x40000400 LIN size 0x400
0x40000800 UARTA size 0x400 — Universal Asynchronous Transceiver
0x40000C00 UARTB size 0x400
0x40001000 UARTC size 0x400
0x40001400 SPIA size 0x400 — SPI
0x40001800 I2CA size 0x400 — I2C
0x40001C00 I2CB size 0x400 — I2C
0x40002000 PMBUS size 0x400
0x40002400 CANA size 0x800 — CAN
0x40002C00 CANFDA size 0x800
0x40010000 WDT size 0xC0 — Watchdog Timer
0x400100C0 NMI size 0x18 — Non-maskable interrupt
0x40010400 EXTI size 0x400
0x40010800 DCS_B0Z1 size 0x60 — Dual Code Security for BANK0 Zone1
0x40010880 DCS_B0Z2 size 0x60 — Dual Code Security for BANK0 Zone2
0x400108E0 DCS_COMMON size 0x20 — Dual Code Security for common
0x40010A00 DCS_B1Z1 size 0x60 — Dual Code Security for BANK1 Zone1
0x40010A80 DCS_B1Z2 size 0x60 — Dual Code Security for BANK1 Zone2
0x40012800 CFGSMS size 0x400 — Configurable Static Memory Subsystem(CFGSMS)
0x40012C00 SPEC size 0x400 — SPEC_REGS
0x40013000 DMA_CHSEL size 0x100 — DMA Channel Trigger Source Select
0x40013100 DEV size 0x300 — DEV_REGS
0x40013400 CLK size 0x200 — CLK_REGS
0x40013600 CPU size 0x200 — CPU_REGS
0x40013800 PERIPH size 0x400 — PERIPH_REGS
0x40013C00 ROM_PREFETCH size 0x100
0x40013D00 ROM_WAIT_STATE size 0x100
0x40016C00 AS size 0x400 — Analog Subsystem (AS)
0x40017000 TMR0 size 0x400 — Timer
0x40017400 TMR1 size 0x400
0x40017800 TMR2 size 0x400
0x40017C00 NVMC size 0x800
0x40018400 DMA size 0x40 — Direct Memory Access (DMA)
0x40018440 DMA_CH1 size 0x40 — DMA_CH_REGS
0x40018480 DMA_CH2 size 0x40
0x400184C0 DMA_CH3 size 0x40
0x40018500 DMA_CH4 size 0x40
0x40018540 DMA_CH5 size 0x40
0x40018580 DMA_CH6 size 0x40
0x40020000 QEP1 size 0x400 — Quadrature Encoder Pulse
0x40020400 CAP1 size 0x400 — Enhanced capture (CAP) module
0x40020800 CAP2 size 0x400
0x40020C00 CAP3 size 0x400
0x40021000 COMP1 size 0x400 — Comparator
0x40021400 COMP2 size 0x400
0x40021800 COMP3 size 0x400
0x40021C00 COMP4 size 0x400
0x40022000 FLB1_LCFG size 0x100 — FLB_LOGIC_CONFIG_REGS Registers
0x40022200 FLB1_LCTRL size 0x100 — FLB_LOGIC_CONTROL_REGS Registers
0x40022400 FLB1_DATAEXCH size 0x400 — FLB_DATA_EXCHANGE_REGS Registers
0x40022800 FLB2_LCFG size 0x100 — FLB_LOGIC_CONFIG_REGS Registers
0x40022A00 FLB2_LCTRL size 0x100 — FLB_LOGIC_CONTROL_REGS Registers
0x40022C00 FLB2_DATAEXCH size 0x400 — FLB_DATA_EXCHANGE_REGS Registers
0x40023000 FLB3_LCFG size 0x100 — FLB_LOGIC_CONFIG_REGS Registers
0x40023200 FLB3_LCTRL size 0x100 — FLB_LOGIC_CONTROL_REGS Registers
0x40023400 FLB3_DATAEXCH size 0x400 — FLB_DATA_EXCHANGE_REGS Registers
0x40023800 FLB4_LCFG size 0x100 — FLB_LOGIC_CONFIG_REGS Registers
0x40023A00 FLB4_LCTRL size 0x100 — FLB_LOGIC_CONTROL_REGS Registers
0x40023C00 FLB4_DATAEXCH size 0x400 — FLB_DATA_EXCHANGE_REGS Registers
0x40024000 DACA size 0x400 — DAC
0x40024400 DACB size 0x400
0x40030000 GPIOCTRL size 0x800 — GPIO CTRL Registers
0x40030800 GPIODATA size 0x100 — GPIO DATA Registers
0x40030900 GPIODATA_READ size 0x100 — GPIO DATA Read Registers
0x40030C00 INPUTXBAR size 0x80
0x40030C80 PWM_SYNC_SOC size 0x380
0x40031000 XBAR size 0x40 — Crossbar
0x400311C0 PWM_XBAR size 0x80
0x40031240 FLB_XBAR size 0x80
0x400312C0 OUTPUT_XBAR size 0x80 — GPIO Output X-BAR
0x50000000 PWM1 size 0x400 — Pulse Width Modulator
0x50000400 PWM2 size 0x400
0x50000800 PWM3 size 0x400
0x50000C00 PWM4 size 0x400
0x50001000 PWM5 size 0x400
0x50001400 PWM6 size 0x400
0x50001800 PWM7 size 0x400
0x50001C00 ADCA size 0x100 — Analog-to-digital converter
0x50001D00 ADCARESULT size 0x100 — Analog-to-digital converter
0x50002000 ADCC size 0x100 — Analog-to-digital converter
0x50002100 ADCCRESULT size 0x30 — Analog-to-digital converter
0xE0001000 DWT size 0x1000
0xE0059000 DBGMCU size 0x400

## Interrupts
11 DCCOMP (DCCOMP0) — DCCOMP interrupt
13 TMR1 — CPU Timer 1 interrupt
14 TMR2 — CPU Timer 2 interrupt
16 RAM (CFGSMS) — RAM Interrupt
32 ADCA1 (ADCA) — ADCA1 global interrupt
34 ADCC1 (ADCC) — ADCC1 global interrupt
38 TMR0 — Timer 0 interrupt
39 WWDT_WAKE (WDT) — WWDT interrupt & LPM wakeup
40 PWM1_TRIP_ZONE (PWM1) — PWM1 Trip Zone Interrupt
41 PWM2_TRIP_ZONE (PWM2) — PWM2 Trip Zone Interrupt
42 PWM3_TRIP_ZONE (PWM3) — PWM3 Trip Zone Interrupt
43 PWM4_TRIP_ZONE (PWM4) — PWM4 Trip Zone Interrupt
44 PWM5_TRIP_ZONE (PWM5) — PWM5 Trip Zone Interrupt
45 PWM6_TRIP_ZONE (PWM6) — PWM6 Trip Zone Interrupt
46 PWM7_TRIP_ZONE (PWM7) — PWM7 Trip Zone Interrupt
48 PWM1 — PWM1 Interrupt
49 PWM2 — PWM2 Interrupt
50 PWM3 — PWM3 Interrupt
51 PWM4 — PWM4 Interrupt
52 PWM5 — PWM5 Interrupt
53 PWM6 — PWM6 Interrupt
54 PWM7 — PWM7 Interrupt
56 CAP1 — CAP1 Interrupt
57 CAP2 — CAP2 Interrupt
58 CAP3 — CAP3 Interrupt
64 QEP1 — QEP1 Interrupt
68 FLB1 (FLB1_LCFG) — FLB1 Interrupt
69 FLB2 (FLB2_LCFG) — FLB2 Interrupt
70 FLB3 (FLB3_LCFG) — FLB3 Interrupt
71 FLB4 (FLB4_LCFG) — FLB4 Interrupt
72 SPIA_RX (SPIA) — SPIA Receive interrupt
73 SPIA_TX (SPIA) — SPIA Transmit interrupt
80 DMA_CH1 — DMA Channel 1 Interrupt
81 DMA_CH2 — DMA Channel 2 Interrupt
82 DMA_CH3 — DMA Channel 3 Interrupt
83 DMA_CH4 — DMA Channel 4 Interrupt
84 DMA_CH5 — DMA Channel 5 Interrupt
85 DMA_CH6 — DMA Channel 6 Interrupt
88 I2CA — I2CA interrupt
89 I2CA_FIFO (I2CA) — I2CA FIFO interrupt
91 I2CB — I2CB interrupt
92 I2CB_FIFO (I2CB) — I2CB FIFO interrupt
96 UARTA_RX (UARTA) — UARTA Receive Interrupt
97 UARTA_TX (UARTA) — UARTA Transmit Interrupt
98 UARTB_RX (UARTB) — UARTB Receive Interrupt
99 UARTB_TX (UARTB) — UARTB Transmit Interrupt
100 CANA_INT0 (CANA) — CANA interrupt 0
101 CANA_INT1 (CANA) — CANA interrupt 1
104 ADCA_EVENT (ADCA) — ADCA Event interrupt
105 ADCA2 (ADCA) — ADCA2 global interrupt
106 ADCA3 (ADCA) — ADCA3 global interrupt
107 ADCA4 (ADCA) — ADCA4 global interrupt
{n+112} EXTI_LINE{n} (EXTI) (n=0..12) — EINT LINE{n} interrupt
129 FPU_DZC (AS) — FPU DZC Interrupt
130 FPU_IDC (AS) — FPU IDC Interrupt
131 FPU_IOC (AS) — FPU IOC Interrupt
132 FPU_OFC (AS) — FPU OFC Interrupt
133 FPU_UFC (AS) — FPU UFC Interrupt
134 FPU_IXC (AS) — FPU IXC Interrupt
169 CANFDA_INT0 (CANFDA) — CANFDA interrupt 0
170 CANFDA_INT1 (CANFDA) — CANFDA interrupt 1
171 CANFDA_BEC_INT (CANFDA) — CANFDA ECC single-bit error interrupt
172 CANFDA_BEU_INT (CANFDA) — CANFDA ECC multi-bit error interrupt
173 CANFDA_WAKE_UP_INT (CANFDA) — CANFDA low power wake interrupt
184 LINA_INT1 (LIN)
185 LINA_INT2 (LIN)
186 UARTC_RX (UARTC) — UARTC Receive Interrupt
187 UARTC_TX (UARTC) — UARTC Transmit Interrupt
188 PMBUSA (PMBUS) — PMBUSA Interrupt
200 ADCC_EVENT (ADCC) — ADCC Event interrupt
201 ADCC2 (ADCC) — ADCC2 global interrupt
202 ADCC3 (ADCC) — ADCC3 global interrupt
203 ADCC4 (ADCC) — ADCC4 global interrupt
218 FLASH_ECC_ERR (NVMC) — Flash ECC correctable error interrupt
220 SYS_PLL_SLIP (AS) — System PLL Slip Interrupt
225 CTI_INT0 (AS) — CTI Interrupt 0 Interrupt
226 CTI_INT1 (AS) — CTI Interrupt 1 Interrupt
