# G32R501 register map
Vendor: Geehy Semiconductor Co., Ltd.; Series: G32R5; File version: 1.0
CPU: CM55 r0p1, little endian, MPU, FPU, double-precision FPU, DSP, VTOR, 4 interrupt priority bits
Registers are 32-bit, read-write, reset 0x0 unless marked. A register's access mark holds for its fields unless they carry their own. Offsets are from the block's base; lines under a group give offsets from that group; [hi:lo] are bit positions; {n}, {i} and the like mark numbered series; 'fields as' and 'values as' point back to an identical list; <NAME> marks a mode.

## Memory map
0x40000000 PWM1 size 0x400 — Pulse Width Modulator
0x40000400 PWM2 size 0x400
0x40000800 PWM3 size 0x400
0x40000C00 PWM4 size 0x400
0x40001000 PWM5 size 0x400
0x40001400 PWM6 size 0x400
0x40001800 PWM7 size 0x400
0x40001C00 PWM8 size 0x400
0x40002000 CAP1 size 0x400 — Enhanced capture (CAP) module
0x40002400 CAP2 size 0x400
0x40002800 CAP3 size 0x400
0x40002C00 CAP4 size 0x400
0x40003000 CAP5 size 0x400
0x40003400 CAP6 size 0x40
0x40003440 HRCAP6 size 0x40 — Enhanced capture (CAP) module
0x40003800 CAP7 size 0x40
0x40003840 HRCAP7 size 0x40 — Enhanced capture (CAP) module
0x40003C00 SDF size 0x400 — Sigma delta filter
0x40011C00 COMP1 size 0x400 — Comparator
0x40012000 COMP2 size 0x400
0x40012400 COMP3 size 0x400
0x40012800 COMP4 size 0x400
0x40012C00 COMP5 size 0x400
0x40013000 COMP6 size 0x400
0x40013400 COMP7 size 0x400
0x40013800 QEP1 size 0x400 — Quadrature Encoder Pulse
0x40013C00 QEP2 size 0x400
0x40020000 ADCA size 0x100 — Analog-to-digital converter
0x40020100 ADCARESULT size 0x100 — Analog-to-digital converter
0x40020400 ADCB size 0x100 — Analog-to-digital converter
0x40020500 ADCBRESULT size 0x30 — Analog-to-digital converter
0x40020800 ADCC size 0x100 — Analog-to-digital converter
0x40020900 ADCCRESULT size 0x30 — Analog-to-digital converter
0x40030000 GPIOCTRL size 0x800 — GPIO CTRL Registers
0x40030800 GPIODATA size 0x400 — GPIO DATA Registers
0x40030C00 INPUTX_BAR size 0x80 — Input X-BAR (XBAR_INPUT)
0x40030C80 PWM_SYNC_SOC size 0x380
0x40031000 XBAR size 0x40 — Crossbar
0x400311C0 PWM_XBAR size 0x80 — PWM X-BAR (XBAR_PWM)
0x40031240 FLB_XBAR size 0x80 — FLB X-BAR (XBAR_FLB)
0x400312C0 OUTPUT_XBAR size 0x80 — GPIO Output X-BAR (XBAR_OUTPUT)
0x50000000 LIN size 0x400
0x50000C00 UARTA size 0x400 — Universal Asynchronous Transceiver
0x50001000 SPIA size 0x400 — SPI
0x50001400 I2CA size 0x400 — I2C
0x50001800 DACA size 0x400 — DAC
0x50001C00 DACB size 0x400
0x50002000 CANA size 0x800 — CAN
0x50010000 NVMC size 0x800
0x50010800 CFGSMS size 0x400 — Configurable Static Memory Subsystem(CFGSMS)
0x50020000 SPEC size 0x400 — SPEC_REGS
0x50020400 DMA_CHSEL size 0x100 — DMA Channel Trigger Source Select
0x50020500 DEV size 0x300 — DEV_REGS
0x50020800 CLK size 0x200 — CLK_REGS
0x50020A00 CPU size 0x200 — CPU_REGS
0x50020C00 PERIPH size 0x400 — PERIPH_REGS
0x50021000 ROM_PREFETCH size 0x100
0x50021100 ROM_WAIT_STATE size 0x100
0x50024000 DCS_B0Z1 size 0x60 — Dual Code Security for BANK0 Zone1
0x50024080 DCS_B0Z2 size 0x60 — Dual Code Security for BANK0 Zone2
0x500240E0 DCS_COMMON size 0x20 — Dual Code Security for common
0x50024200 DCS_B1Z1 size 0x60 — Dual Code Security for BANK1 Zone1
0x50024280 DCS_B1Z2 size 0x60 — Dual Code Security for BANK1 Zone2
0x50026000 QSPI size 0x400
0x50026400 WDT size 0xC0 — Watchdog Timer
0x500264C0 NMI size 0x340 — Non-maskable interrupt
0x50028000 AS size 0x400 — Analog Subsystem (AS)
0x50100000 UARTB size 0x400
0x50100400 SPIB size 0x400
0x50100800 PMBUS size 0x400
0x50100C00 FSI_TX size 0x400 — Fast Serial Interface
0x50101000 FSI_RX size 0x400 — Fast Serial Interface
0x50101400 DCCOMP0 size 0x400 — Dual-Clock Comparator
0x50101800 CANB size 0x800
0x50102000 FLB1_LCFG size 0x100 — FLB_LOGIC_CONFIG_REGS Registers
0x50102200 FLB1_LCTRL size 0x100 — FLB_LOGIC_CONTROL_REGS Registers
0x50102400 FLB1_DATAEXCH size 0x400 — FLB_DATA_EXCHANGE_REGS Registers
0x50102800 FLB2_LCFG size 0x100 — FLB_LOGIC_CONFIG_REGS Registers
0x50102A00 FLB2_LCTRL size 0x100 — FLB_LOGIC_CONTROL_REGS Registers
0x50102C00 FLB2_DATAEXCH size 0x400 — FLB_DATA_EXCHANGE_REGS Registers
0x50103000 FLB3_LCFG size 0x100 — FLB_LOGIC_CONFIG_REGS Registers
0x50103200 FLB3_LCTRL size 0x100 — FLB_LOGIC_CONTROL_REGS Registers
0x50103400 FLB3_DATAEXCH size 0x400 — FLB_DATA_EXCHANGE_REGS Registers
0x50103800 FLB4_LCFG size 0x100 — FLB_LOGIC_CONFIG_REGS Registers
0x50103A00 FLB4_LCTRL size 0x100 — FLB_LOGIC_CONTROL_REGS Registers
0x50103C00 FLB4_DATAEXCH size 0x400 — FLB_DATA_EXCHANGE_REGS Registers
0x50110000 TMR0 size 0x400 — Timer
0x50110400 TMR1 size 0x400
0x50110800 TMR2 size 0x400
0x50110C00 DMA size 0x40 — Direct Memory Access (DMA)
0x50110C40 DMA_CH1 size 0x40 — DMA_CH_REGS
0x50110C80 DMA_CH2 size 0x40
0x50110CC0 DMA_CH3 size 0x40
0x50110D00 DMA_CH4 size 0x40
0x50110D40 DMA_CH5 size 0x40
0x50110D80 DMA_CH6 size 0x40
0x50111000 EXTI size 0x400
0xE0001000 DWT size 0x1000
0xE0059000 DBGMCU size 0x400

## Interrupts
11 DCCOMP0 — DCCOMP0 interrupt
13 TMR1 — TMR1 interrupt
14 TMR2 — TMR2 interrupt
16 RAM (CFGSMS) — RAM Interrupt
17 IPC_TE0 (AS) — IPC TE0 Interrupt
18 IPC_TE1 (AS) — IPC TE1 Interrupt
19 IPC_TE2 (AS) — IPC TE2 Interrupt
20 IPC_TE3 (AS) — IPC TE3 Interrupt
21 IPC_RF0 (AS) — IPC RF0 Interrupt
22 IPC_RF1 (AS) — IPC RF1 Interrupt
23 IPC_RF2 (AS) — IPC RF2 Interrupt
24 IPC_RF3 (AS) — IPC RF3 Interrupt
25 IPC_GP0 (AS) — IPC GP0 Interrupt
26 IPC_GP1 (AS) — IPC GP1 Interrupt
27 IPC_GP2 (AS) — IPC GP2 Interrupt
28 IPC_GP3 (AS) — IPC GP3 Interrupt
32 ADCA1 (ADCA) — ADCA1 global interrupt
33 ADCB1 (ADCB) — ADCB1 global interrupt
34 ADCC1 (ADCC) — ADCC1 global interrupt
38 TMR0 — TMR0 interrupt
39 WDT — Watchdog interrupt
{n+39} PWM{n}_TZ (PWM{n}) (n=1..8) — PWM{n} Trip Zone Interrupt
{n+47} PWM{n} (n=1..8) — PWM{n} Interrupt
56 CAP1 — CAP1 Interrupt
57 CAP2 — CAP2 Interrupt
58 CAP3 — CAP3 Interrupt
59 CAP4 — CAP4 Interrupt
60 CAP5 — CAP5 Interrupt
61 CAP6 — CAP6 Interrupt
62 CAP7 — CAP7 Interrupt
64 QEP1 — QEP1 Interrupt
65 QEP2 — QEP2 Interrupt
68 FLB1 (FLB1_LCFG) — FLB1 Interrupt
69 FLB2 (FLB2_LCFG) — FLB2 Interrupt
70 FLB3 (FLB3_LCFG) — FLB3 Interrupt
71 FLB4 (FLB4_LCFG) — FLB4 Interrupt
72 SPIA_RX (SPIA) — SPIA_RX interrupt
73 SPIA_TX (SPIA) — SPIA_TX interrupt
74 SPIB_RX (SPIB) — SPIB_RX interrupt
75 SPIB_TX (SPIB) — SPIB_TX interrupt
80 DMA_CH1 — DMA Channel 1 Interrupt
81 DMA_CH2 — DMA Channel 2 Interrupt
82 DMA_CH3 — DMA Channel 3 Interrupt
83 DMA_CH4 — DMA Channel 4 Interrupt
84 DMA_CH5 — DMA Channel 5 Interrupt
85 DMA_CH6 — DMA Channel 6 Interrupt
88 I2CA — I2CA interrupt
89 I2CA_FIFO (I2CA) — I2CA FIFO interrupt
90 QSPI — QSPI interrupt
96 UARTA_RX (UARTA) — UARTA Receive Interrupt
97 UARTA_TX (UARTA) — UARTA Transmit Interrupt
98 UARTB_RX (UARTB) — UARTB Receive Interrupt
99 UARTB_TX (UARTB) — UARTB Transmit Interrupt
100 CANA_INT0 (CANA) — CANA interrupt 0
101 CANA_INT1 (CANA) — CANA interrupt 1
102 CANB_INT0 (CANB) — CANB interrupt 0
103 CANB_INT1 (CANB) — CANB interrupt 1
104 ADCA_EVENT (ADCA) — ADCA Event interrupt
105 ADCA2 (ADCA) — ADCA2 global interrupt
106 ADCA3 (ADCA) — ADCA3 global interrupt
107 ADCA4 (ADCA) — ADCA4 global interrupt
108 ADCB_EVENT (ADCB) — ADCB Event interrupt
109 ADCB2 (ADCB) — ADCB2 global interrupt
110 ADCB3 (ADCB) — ADCB3 global interrupt
111 ADCB4 (ADCB) — ADCB4 global interrupt
{n+112} EINT_LINE{n} (EXTI) (n=0..15) — EINT LINE{n} interrupt
129 FPU_DZC (AS) — FPU DZC Interrupt
130 FPU_IDC (AS) — FPU IDC Interrupt
131 FPU_IOC (AS) — FPU IOC Interrupt
132 FPU_OFC (AS) — FPU OFC Interrupt
133 FPU_UFC (AS) — FPU UFC Interrupt
134 FPU_IXC (AS) — FPU IXC Interrupt
157 CAP6_HRcalibration (HRCAP6) — CAP6_HRcalibration Interrupt
158 CAP7_HRcalibration (HRCAP7) — CAP7_HRcalibration Interrupt
160 SDF — SDF Interrupt
164 SDF_DR_INT1 (SDF) — SDF DR Interrupt 1
165 SDF_DR_INT2 (SDF) — SDF DR Interrupt 2
166 SDF_DR_INT3 (SDF) — SDF DR Interrupt 3
167 SDF_DR_INT4 (SDF) — SDF DR Interrupt 4
178 FSITXA_INT1 (FSI_TX) — FSITXA_INT1 Interrupt
179 FSITXA_INT2 (FSI_TX) — FSITXA_INT2 Interrupt
180 FSIRXA_INT1 (FSI_RX) — FSIRXA_INT1 Interrupt
181 FSIRXA_INT2 (FSI_RX) — FSIRXA_INT2 Interrupt
184 LINA_INT1 (LIN) — LINA Interrupt 1
185 LINA_INT2 (LIN) — LINA Interrupt 2
188 PMBUSA (PMBUS) — PMBUSA Interrupt
200 ADCC_EVENT (ADCC) — ADCC Event interrupt
201 ADCC2 (ADCC) — ADCC2 global interrupt
202 ADCC3 (ADCC) — ADCC3 global interrupt
203 ADCC4 (ADCC) — ADCC4 global interrupt
218 FLASH_CORR_ERR (AS) — Flash Correctable Error Interrupt
220 SYS_PLL_SLIP (AS) — System PLL Slip Interrupt
225 CTI_0 (AS) — CTI Interrupt 0 Interrupt
226 CTI_1 (AS) — CTI Interrupt 1 Interrupt
